## config/boards/shields/narsil3.2/Kconfig.defconfig
```kconfig
# Copyright (c) 2021 The ZMK Contributors
# SPDX-License-Identifier: MIT

if SHIELD_NARSIL_LEFT

config ZMK_KEYBOARD_NAME
	default "narsil"

config ZMK_SPLIT_ROLE_CENTRAL
	default y

endif

if SHIELD_NARSIL_LEFT || SHIELD_NARSIL_RIGHT

config ZMK_SPLIT
	default y

endif
```
